#include "display.h"

#include <string.h>
#include <assert.h>
#include <math.h>
#include "esp_check.h"
#include "esp_err.h"
#include "esp_log.h"
#include "esp_lcd_panel_io.h"
#include "esp_lcd_panel_ops.h"
#include "esp_lcd_panel_vendor.h"
#include "esp_lcd_types.h"
#include "esp_heap_caps.h"
#include "driver/spi_master.h"
#include "driver/gpio.h"
#include "freertos/FreeRTOS.h"
#include "freertos/task.h"
#include "board.h"

static const char *TAG = "display";

/* ── Panel and framebuffer ───────────────────────────────────────────── */

static esp_lcd_panel_handle_t panel_handle;
static uint16_t *fb; /* PSRAM framebuffer, BOARD_LCD_H_RES × BOARD_LCD_V_RES */

#define FB_SIZE (BOARD_LCD_H_RES * BOARD_LCD_V_RES)
#define FB_BYTES (FB_SIZE * sizeof(uint16_t))

/* ── 8×16 monospace bitmap font (ASCII 0x20 – 0x7E) ──────────────────── */

static const uint8_t font8x16[95][16] = {
    /* 0x20 ' ' */ {0x00,0x00,0x00,0x00,0x00,0x00,0x00,0x00,0x00,0x00,0x00,0x00,0x00,0x00,0x00,0x00},
    /* 0x21 '!' */ {0x00,0x00,0x00,0x18,0x3C,0x3C,0x3C,0x18,0x18,0x00,0x18,0x18,0x00,0x00,0x00,0x00},
    /* 0x22 '"' */ {0x00,0x00,0x66,0x66,0x66,0x24,0x00,0x00,0x00,0x00,0x00,0x00,0x00,0x00,0x00,0x00},
    /* 0x23 '#' */ {0x00,0x00,0x00,0x6C,0x6C,0xFE,0x6C,0x6C,0x6C,0xFE,0x6C,0x6C,0x00,0x00,0x00,0x00},
    /* 0x24 '$' */ {0x18,0x18,0x7C,0xC6,0xC2,0xC0,0x7C,0x06,0x86,0xC6,0x7C,0x18,0x18,0x00,0x00,0x00},
    /* 0x25 '%' */ {0x00,0x00,0x00,0x00,0xC2,0xC6,0x0C,0x18,0x30,0x66,0xC6,0x00,0x00,0x00,0x00,0x00},
    /* 0x26 '&' */ {0x00,0x00,0x00,0x38,0x6C,0x6C,0x38,0x76,0xDC,0xCC,0xCC,0x76,0x00,0x00,0x00,0x00},
    /* 0x27 ''' */ {0x00,0x00,0x30,0x30,0x30,0x60,0x00,0x00,0x00,0x00,0x00,0x00,0x00,0x00,0x00,0x00},
    /* 0x28 '(' */ {0x00,0x00,0x0C,0x18,0x30,0x30,0x30,0x30,0x30,0x30,0x18,0x0C,0x00,0x00,0x00,0x00},
    /* 0x29 ')' */ {0x00,0x00,0x30,0x18,0x0C,0x0C,0x0C,0x0C,0x0C,0x0C,0x18,0x30,0x00,0x00,0x00,0x00},
    /* 0x2A '*' */ {0x00,0x00,0x00,0x00,0x00,0x66,0x3C,0xFF,0x3C,0x66,0x00,0x00,0x00,0x00,0x00,0x00},
    /* 0x2B '+' */ {0x00,0x00,0x00,0x00,0x00,0x18,0x18,0x7E,0x18,0x18,0x00,0x00,0x00,0x00,0x00,0x00},
    /* 0x2C ',' */ {0x00,0x00,0x00,0x00,0x00,0x00,0x00,0x00,0x00,0x18,0x18,0x18,0x30,0x00,0x00,0x00},
    /* 0x2D '-' */ {0x00,0x00,0x00,0x00,0x00,0x00,0x00,0xFE,0x00,0x00,0x00,0x00,0x00,0x00,0x00,0x00},
    /* 0x2E '.' */ {0x00,0x00,0x00,0x00,0x00,0x00,0x00,0x00,0x00,0x00,0x18,0x18,0x00,0x00,0x00,0x00},
    /* 0x2F '/' */ {0x00,0x00,0x00,0x00,0x02,0x06,0x0C,0x18,0x30,0x60,0xC0,0x80,0x00,0x00,0x00,0x00},
    /* 0x30 '0' */ {0x00,0x00,0x00,0x38,0x6C,0xC6,0xC6,0xD6,0xC6,0xC6,0x6C,0x38,0x00,0x00,0x00,0x00},
    /* 0x31 '1' */ {0x00,0x00,0x00,0x18,0x38,0x78,0x18,0x18,0x18,0x18,0x18,0x7E,0x00,0x00,0x00,0x00},
    /* 0x32 '2' */ {0x00,0x00,0x00,0x7C,0xC6,0x06,0x0C,0x18,0x30,0x60,0xC6,0xFE,0x00,0x00,0x00,0x00},
    /* 0x33 '3' */ {0x00,0x00,0x00,0x7C,0xC6,0x06,0x06,0x3C,0x06,0x06,0xC6,0x7C,0x00,0x00,0x00,0x00},
    /* 0x34 '4' */ {0x00,0x00,0x00,0x0C,0x1C,0x3C,0x6C,0xCC,0xFE,0x0C,0x0C,0x1E,0x00,0x00,0x00,0x00},
    /* 0x35 '5' */ {0x00,0x00,0x00,0xFE,0xC0,0xC0,0xC0,0xFC,0x06,0x06,0xC6,0x7C,0x00,0x00,0x00,0x00},
    /* 0x36 '6' */ {0x00,0x00,0x00,0x38,0x60,0xC0,0xC0,0xFC,0xC6,0xC6,0xC6,0x7C,0x00,0x00,0x00,0x00},
    /* 0x37 '7' */ {0x00,0x00,0x00,0xFE,0xC6,0x06,0x06,0x0C,0x18,0x30,0x30,0x30,0x00,0x00,0x00,0x00},
    /* 0x38 '8' */ {0x00,0x00,0x00,0x7C,0xC6,0xC6,0xC6,0x7C,0xC6,0xC6,0xC6,0x7C,0x00,0x00,0x00,0x00},
    /* 0x39 '9' */ {0x00,0x00,0x00,0x7C,0xC6,0xC6,0xC6,0x7E,0x06,0x06,0x0C,0x78,0x00,0x00,0x00,0x00},
    /* 0x3A ':' */ {0x00,0x00,0x00,0x00,0x00,0x18,0x18,0x00,0x00,0x00,0x18,0x18,0x00,0x00,0x00,0x00},
    /* 0x3B ';' */ {0x00,0x00,0x00,0x00,0x00,0x18,0x18,0x00,0x00,0x18,0x18,0x18,0x30,0x00,0x00,0x00},
    /* 0x3C '<' */ {0x00,0x00,0x00,0x06,0x0C,0x18,0x30,0x60,0x30,0x18,0x0C,0x06,0x00,0x00,0x00,0x00},
    /* 0x3D '=' */ {0x00,0x00,0x00,0x00,0x00,0x00,0xFE,0x00,0x00,0xFE,0x00,0x00,0x00,0x00,0x00,0x00},
    /* 0x3E '>' */ {0x00,0x00,0x00,0x60,0x30,0x18,0x0C,0x06,0x0C,0x18,0x30,0x60,0x00,0x00,0x00,0x00},
    /* 0x3F '?' */ {0x00,0x00,0x00,0x7C,0xC6,0xC6,0x0C,0x18,0x18,0x00,0x18,0x18,0x00,0x00,0x00,0x00},
    /* 0x40 '@' */ {0x00,0x00,0x00,0x7C,0xC6,0xC6,0xDE,0xDE,0xDE,0xDC,0xC0,0x7C,0x00,0x00,0x00,0x00},
    /* 0x41 'A' */ {0x00,0x00,0x00,0x10,0x38,0x6C,0xC6,0xC6,0xFE,0xC6,0xC6,0xC6,0x00,0x00,0x00,0x00},
    /* 0x42 'B' */ {0x00,0x00,0x00,0xFC,0x66,0x66,0x66,0x7C,0x66,0x66,0x66,0xFC,0x00,0x00,0x00,0x00},
    /* 0x43 'C' */ {0x00,0x00,0x00,0x3C,0x66,0xC2,0xC0,0xC0,0xC0,0xC2,0x66,0x3C,0x00,0x00,0x00,0x00},
    /* 0x44 'D' */ {0x00,0x00,0x00,0xF8,0x6C,0x66,0x66,0x66,0x66,0x66,0x6C,0xF8,0x00,0x00,0x00,0x00},
    /* 0x45 'E' */ {0x00,0x00,0x00,0xFE,0x66,0x62,0x68,0x78,0x68,0x62,0x66,0xFE,0x00,0x00,0x00,0x00},
    /* 0x46 'F' */ {0x00,0x00,0x00,0xFE,0x66,0x62,0x68,0x78,0x68,0x60,0x60,0xF0,0x00,0x00,0x00,0x00},
    /* 0x47 'G' */ {0x00,0x00,0x00,0x3C,0x66,0xC2,0xC0,0xC0,0xDE,0xC6,0x66,0x3A,0x00,0x00,0x00,0x00},
    /* 0x48 'H' */ {0x00,0x00,0x00,0xC6,0xC6,0xC6,0xC6,0xFE,0xC6,0xC6,0xC6,0xC6,0x00,0x00,0x00,0x00},
    /* 0x49 'I' */ {0x00,0x00,0x00,0x3C,0x18,0x18,0x18,0x18,0x18,0x18,0x18,0x3C,0x00,0x00,0x00,0x00},
    /* 0x4A 'J' */ {0x00,0x00,0x00,0x1E,0x0C,0x0C,0x0C,0x0C,0x0C,0xCC,0xCC,0x78,0x00,0x00,0x00,0x00},
    /* 0x4B 'K' */ {0x00,0x00,0x00,0xE6,0x66,0x6C,0x6C,0x78,0x6C,0x6C,0x66,0xE6,0x00,0x00,0x00,0x00},
    /* 0x4C 'L' */ {0x00,0x00,0x00,0xF0,0x60,0x60,0x60,0x60,0x60,0x62,0x66,0xFE,0x00,0x00,0x00,0x00},
    /* 0x4D 'M' */ {0x00,0x00,0x00,0xC6,0xEE,0xFE,0xFE,0xD6,0xC6,0xC6,0xC6,0xC6,0x00,0x00,0x00,0x00},
    /* 0x4E 'N' */ {0x00,0x00,0x00,0xC6,0xE6,0xF6,0xFE,0xDE,0xCE,0xC6,0xC6,0xC6,0x00,0x00,0x00,0x00},
    /* 0x4F 'O' */ {0x00,0x00,0x00,0x38,0x6C,0xC6,0xC6,0xC6,0xC6,0xC6,0x6C,0x38,0x00,0x00,0x00,0x00},
    /* 0x50 'P' */ {0x00,0x00,0x00,0xFC,0x66,0x66,0x66,0x7C,0x60,0x60,0x60,0xF0,0x00,0x00,0x00,0x00},
    /* 0x51 'Q' */ {0x00,0x00,0x00,0x38,0x6C,0xC6,0xC6,0xC6,0xC6,0xCE,0x6C,0x3E,0x00,0x00,0x00,0x00},
    /* 0x52 'R' */ {0x00,0x00,0x00,0xFC,0x66,0x66,0x66,0x7C,0x6C,0x66,0x66,0xE6,0x00,0x00,0x00,0x00},
    /* 0x53 'S' */ {0x00,0x00,0x00,0x7C,0xC6,0xC6,0x60,0x38,0x0C,0xC6,0xC6,0x7C,0x00,0x00,0x00,0x00},
    /* 0x54 'T' */ {0x00,0x00,0x00,0x7E,0x7E,0x5A,0x18,0x18,0x18,0x18,0x18,0x3C,0x00,0x00,0x00,0x00},
    /* 0x55 'U' */ {0x00,0x00,0x00,0xC6,0xC6,0xC6,0xC6,0xC6,0xC6,0xC6,0xC6,0x7C,0x00,0x00,0x00,0x00},
    /* 0x56 'V' */ {0x00,0x00,0x00,0xC6,0xC6,0xC6,0xC6,0xC6,0xC6,0x6C,0x38,0x10,0x00,0x00,0x00,0x00},
    /* 0x57 'W' */ {0x00,0x00,0x00,0xC6,0xC6,0xC6,0xC6,0xD6,0xD6,0xFE,0x6C,0x6C,0x00,0x00,0x00,0x00},
    /* 0x58 'X' */ {0x00,0x00,0x00,0xC6,0xC6,0x6C,0x7C,0x38,0x7C,0x6C,0xC6,0xC6,0x00,0x00,0x00,0x00},
    /* 0x59 'Y' */ {0x00,0x00,0x00,0x66,0x66,0x66,0x66,0x3C,0x18,0x18,0x18,0x3C,0x00,0x00,0x00,0x00},
    /* 0x5A 'Z' */ {0x00,0x00,0x00,0xFE,0xC6,0x86,0x0C,0x18,0x30,0x62,0xC6,0xFE,0x00,0x00,0x00,0x00},
    /* 0x5B '[' */ {0x00,0x00,0x3C,0x30,0x30,0x30,0x30,0x30,0x30,0x30,0x30,0x3C,0x00,0x00,0x00,0x00},
    /* 0x5C '\' */ {0x00,0x00,0x00,0x00,0x80,0xC0,0x60,0x30,0x18,0x0C,0x06,0x02,0x00,0x00,0x00,0x00},
    /* 0x5D ']' */ {0x00,0x00,0x3C,0x0C,0x0C,0x0C,0x0C,0x0C,0x0C,0x0C,0x0C,0x3C,0x00,0x00,0x00,0x00},
    /* 0x5E '^' */ {0x10,0x38,0x6C,0xC6,0x00,0x00,0x00,0x00,0x00,0x00,0x00,0x00,0x00,0x00,0x00,0x00},
    /* 0x5F '_' */ {0x00,0x00,0x00,0x00,0x00,0x00,0x00,0x00,0x00,0x00,0x00,0x00,0x00,0xFF,0x00,0x00},
    /* 0x60 '`' */ {0x00,0x30,0x18,0x0C,0x00,0x00,0x00,0x00,0x00,0x00,0x00,0x00,0x00,0x00,0x00,0x00},
    /* 0x61 'a' */ {0x00,0x00,0x00,0x00,0x00,0x78,0x0C,0x7C,0xCC,0xCC,0xCC,0x76,0x00,0x00,0x00,0x00},
    /* 0x62 'b' */ {0x00,0x00,0x00,0xE0,0x60,0x60,0x78,0x6C,0x66,0x66,0x66,0x7C,0x00,0x00,0x00,0x00},
    /* 0x63 'c' */ {0x00,0x00,0x00,0x00,0x00,0x7C,0xC6,0xC0,0xC0,0xC0,0xC6,0x7C,0x00,0x00,0x00,0x00},
    /* 0x64 'd' */ {0x00,0x00,0x00,0x1C,0x0C,0x0C,0x3C,0x6C,0xCC,0xCC,0xCC,0x76,0x00,0x00,0x00,0x00},
    /* 0x65 'e' */ {0x00,0x00,0x00,0x00,0x00,0x7C,0xC6,0xFE,0xC0,0xC0,0xC6,0x7C,0x00,0x00,0x00,0x00},
    /* 0x66 'f' */ {0x00,0x00,0x00,0x1C,0x36,0x32,0x30,0x78,0x30,0x30,0x30,0x78,0x00,0x00,0x00,0x00},
    /* 0x67 'g' */ {0x00,0x00,0x00,0x00,0x00,0x76,0xCC,0xCC,0xCC,0xCC,0xCC,0x7C,0x0C,0xCC,0x78,0x00},
    /* 0x68 'h' */ {0x00,0x00,0x00,0xE0,0x60,0x60,0x6C,0x76,0x66,0x66,0x66,0xE6,0x00,0x00,0x00,0x00},
    /* 0x69 'i' */ {0x00,0x00,0x00,0x18,0x18,0x00,0x38,0x18,0x18,0x18,0x18,0x3C,0x00,0x00,0x00,0x00},
    /* 0x6A 'j' */ {0x00,0x00,0x00,0x06,0x06,0x00,0x0E,0x06,0x06,0x06,0x06,0x06,0x66,0x66,0x3C,0x00},
    /* 0x6B 'k' */ {0x00,0x00,0x00,0xE0,0x60,0x60,0x66,0x6C,0x78,0x78,0x6C,0xE6,0x00,0x00,0x00,0x00},
    /* 0x6C 'l' */ {0x00,0x00,0x00,0x38,0x18,0x18,0x18,0x18,0x18,0x18,0x18,0x3C,0x00,0x00,0x00,0x00},
    /* 0x6D 'm' */ {0x00,0x00,0x00,0x00,0x00,0xEC,0xFE,0xD6,0xD6,0xD6,0xD6,0xD6,0x00,0x00,0x00,0x00},
    /* 0x6E 'n' */ {0x00,0x00,0x00,0x00,0x00,0xDC,0x66,0x66,0x66,0x66,0x66,0x66,0x00,0x00,0x00,0x00},
    /* 0x6F 'o' */ {0x00,0x00,0x00,0x00,0x00,0x7C,0xC6,0xC6,0xC6,0xC6,0xC6,0x7C,0x00,0x00,0x00,0x00},
    /* 0x70 'p' */ {0x00,0x00,0x00,0x00,0x00,0xDC,0x66,0x66,0x66,0x66,0x66,0x7C,0x60,0x60,0xF0,0x00},
    /* 0x71 'q' */ {0x00,0x00,0x00,0x00,0x00,0x76,0xCC,0xCC,0xCC,0xCC,0xCC,0x7C,0x0C,0x0C,0x1E,0x00},
    /* 0x72 'r' */ {0x00,0x00,0x00,0x00,0x00,0xDC,0x76,0x62,0x60,0x60,0x60,0xF0,0x00,0x00,0x00,0x00},
    /* 0x73 's' */ {0x00,0x00,0x00,0x00,0x00,0x7C,0xC6,0x60,0x38,0x0C,0xC6,0x7C,0x00,0x00,0x00,0x00},
    /* 0x74 't' */ {0x00,0x00,0x00,0x10,0x30,0x30,0xFC,0x30,0x30,0x30,0x36,0x1C,0x00,0x00,0x00,0x00},
    /* 0x75 'u' */ {0x00,0x00,0x00,0x00,0x00,0xCC,0xCC,0xCC,0xCC,0xCC,0xCC,0x76,0x00,0x00,0x00,0x00},
    /* 0x76 'v' */ {0x00,0x00,0x00,0x00,0x00,0xC6,0xC6,0xC6,0xC6,0xC6,0x6C,0x38,0x00,0x00,0x00,0x00},
    /* 0x77 'w' */ {0x00,0x00,0x00,0x00,0x00,0xC6,0xC6,0xD6,0xD6,0xD6,0xFE,0x6C,0x00,0x00,0x00,0x00},
    /* 0x78 'x' */ {0x00,0x00,0x00,0x00,0x00,0xC6,0x6C,0x38,0x38,0x38,0x6C,0xC6,0x00,0x00,0x00,0x00},
    /* 0x79 'y' */ {0x00,0x00,0x00,0x00,0x00,0xC6,0xC6,0xC6,0xC6,0xC6,0xC6,0x7E,0x06,0x0C,0xF8,0x00},
    /* 0x7A 'z' */ {0x00,0x00,0x00,0x00,0x00,0xFE,0xCC,0x18,0x30,0x60,0xC6,0xFE,0x00,0x00,0x00,0x00},
    /* 0x7B '{' */ {0x00,0x00,0x0E,0x18,0x18,0x18,0x18,0x70,0x18,0x18,0x18,0x0E,0x00,0x00,0x00,0x00},
    /* 0x7C '|' */ {0x00,0x00,0x18,0x18,0x18,0x18,0x18,0x00,0x18,0x18,0x18,0x18,0x00,0x00,0x00,0x00},
    /* 0x7D '}' */ {0x00,0x00,0x70,0x18,0x18,0x18,0x18,0x0E,0x18,0x18,0x18,0x70,0x00,0x00,0x00,0x00},
    /* 0x7E '~' */ {0x00,0x00,0x76,0xDC,0x00,0x00,0x00,0x00,0x00,0x00,0x00,0x00,0x00,0x00,0x00,0x00},
};

/* ── Internal helpers ────────────────────────────────────────────────── */

static inline uint16_t rgb565(uint8_t r, uint8_t g, uint8_t b)
{
    return (uint16_t)(((r & 0xF8) << 8) | ((g & 0xFC) << 3) | (b >> 3));
}

/** Linear-interpolate two RGB565 colors in their native 5/6/5 component
 *  space. @p t in [0,1], 0 = bg, 1 = fg. Used to anti-alias curved edges
 *  by blending into whatever is already in the framebuffer at that pixel. */
static uint16_t blend565(uint16_t bg, uint16_t fg, float t)
{
    int br = (bg >> 11) & 0x1F, bg6 = (bg >> 5) & 0x3F, bb = bg & 0x1F;
    int fr = (fg >> 11) & 0x1F, fg6 = (fg >> 5) & 0x3F, fb5 = fg & 0x1F;
    int r = br + (int)(t * (float)(fr - br) + 0.5f);
    int g = bg6 + (int)(t * (float)(fg6 - bg6) + 0.5f);
    int b = bb + (int)(t * (float)(fb5 - bb) + 0.5f);
    return (uint16_t)((r << 11) | (g << 5) | b);
}

/** Fill the whole PSRAM framebuffer with @p color. */
static void fb_fill(uint16_t color)
{
    for (size_t i = 0; i < FB_SIZE; i++) {
        fb[i] = color;
    }
}

/** Read one pixel at (x, y). Out-of-bounds returns black. */
static uint16_t fb_get(int x, int y)
{
    if (x < 0 || x >= BOARD_LCD_H_RES || y < 0 || y >= BOARD_LCD_V_RES) return 0;
    return fb[y * BOARD_LCD_H_RES + x];
}

/** Put one pixel at (x, y). Out-of-bounds silently ignored. */
static void fb_put(int x, int y, uint16_t color)
{
    if (x < 0 || x >= BOARD_LCD_H_RES || y < 0 || y >= BOARD_LCD_V_RES) return;
    fb[y * BOARD_LCD_H_RES + x] = color;
}

/* fb lives in PSRAM; the SPI driver can't DMA from PSRAM directly, so
 * esp_lcd_panel_draw_bitmap() would otherwise bounce-copy every ~4KB chunk
 * through a fresh MALLOC_CAP_DMA allocation. Under sustained flushing (face
 * animation) that alloc/free churn on the small internal-RAM DMA pool
 * eventually fails with ESP_ERR_NO_MEM once Wi-Fi/audio buffers are also
 * competing for it. Flush through one persistent internal DMA buffer
 * instead, in a few large bands, so there's no per-chunk allocation.
 *
 * The whole frame (115200 B) doesn't fit as a single contiguous internal
 * block even at boot (measured largest_dma ≈ 76 KB — the LCD/SPI driver's
 * own setup already fragments internal RAM), so it has to be banded. 3
 * bands keeps the CASET/RASET command overhead low (unlike very thin bands,
 * which visibly tear during fast face animation) while comfortably fitting
 * under that ceiling. */
#define FLUSH_BANDS      3
#define FLUSH_BAND_ROWS  (BOARD_LCD_V_RES / FLUSH_BANDS)
/* esp_lcd_panel_draw_bitmap() only *queues* the color DMA transfers — it
 * returns before they finish; they're only waited on at the start of the
 * *next* draw_bitmap call (it issues a new RAMWR command, and the driver
 * drains all prior in-flight transactions before sending any command). So
 * reusing a bounce buffer for band N+1 while band N's DMA is still reading
 * it corrupts the frame — this was visible on screen as garbage/duplicated
 * content at band seams. Two buffers, alternated, are enough: by the time
 * band N+2 wants buffer (N+2)%2 == N%2, band N+1's draw_bitmap call has
 * already forced band N's transfer to finish (that's the drain above), so
 * band N's buffer is safe to reuse. Using 2 instead of FLUSH_BANDS buffers
 * also roughly halves the persistent internal RAM this costs — the naive
 * one-buffer-per-band version didn't reliably fit. */
#define FLUSH_BUFS 2
static uint16_t *s_flush_buf[FLUSH_BUFS]; /* internal DMA-capable, BOARD_LCD_H_RES × FLUSH_BAND_ROWS each */

/** Push the framebuffer to the display. */
static void fb_flush(void)
{
    int band = 0;
    for (int y0 = 0; y0 < BOARD_LCD_V_RES; y0 += FLUSH_BAND_ROWS, band++) {
        int rows = FLUSH_BAND_ROWS;
        if (y0 + rows > BOARD_LCD_V_RES) rows = BOARD_LCD_V_RES - y0;

        uint16_t *buf = s_flush_buf[band % FLUSH_BUFS];
        memcpy(buf, &fb[y0 * BOARD_LCD_H_RES],
               (size_t)rows * BOARD_LCD_H_RES * sizeof(uint16_t));

        esp_err_t r = esp_lcd_panel_draw_bitmap(panel_handle, 0, y0,
                                                BOARD_LCD_H_RES, y0 + rows,
                                                buf);
        if (r != ESP_OK) {
            ESP_LOGE(TAG, "draw_bitmap failed: %s", esp_err_to_name(r));
            return;
        }
    }
}

/* ── Public API ──────────────────────────────────────────────────────── */

void display_init(void)
{
    ESP_LOGI(TAG, "Initializing ST7789 LCD (%dx%d)", BOARD_LCD_H_RES, BOARD_LCD_V_RES);

    /* 1. SPI bus */
    spi_bus_config_t bus_cfg = {
        .sclk_io_num     = BOARD_LCD_PIN_SCLK,
        .mosi_io_num     = BOARD_LCD_PIN_MOSI,
        .miso_io_num     = BOARD_LCD_PIN_MISO,
        .quadwp_io_num   = -1,
        .quadhd_io_num   = -1,
        /* fb lives in PSRAM; the SPI driver can't DMA from PSRAM directly, so
         * every chunk gets bounce-copied through a MALLOC_CAP_DMA allocation
         * sized to this value. Keep it small so that allocation reliably
         * succeeds even under internal-RAM pressure early in boot. */
        .max_transfer_sz = 4096,
    };
    ESP_ERROR_CHECK(spi_bus_initialize(BOARD_LCD_SPI_HOST, &bus_cfg, SPI_DMA_CH_AUTO));

    /* 2. Panel IO */
    esp_lcd_panel_io_spi_config_t io_cfg = {
        .cs_gpio_num = BOARD_LCD_PIN_CS,
        .dc_gpio_num = BOARD_LCD_PIN_DC,
        /* Waveshare's own ESP-IDF example for this exact board (ESP32-S3-LCD-1.54)
         * uses SPI mode 3, not mode 0 — matching it here. */
        .spi_mode    = 3,
        .pclk_hz     = BOARD_LCD_PIXEL_CLOCK_HZ,
        .trans_queue_depth = 10,
        .lcd_cmd_bits   = 8,
        .lcd_param_bits = 8,
    };
    esp_lcd_panel_io_handle_t io_handle = NULL;
    ESP_ERROR_CHECK(esp_lcd_new_panel_io_spi((esp_lcd_spi_bus_handle_t)BOARD_LCD_SPI_HOST,
                                             &io_cfg, &io_handle));

    /* 3. ST7789 panel */
    esp_lcd_panel_dev_config_t panel_cfg = {
        .reset_gpio_num = BOARD_LCD_PIN_RST,
        .rgb_ele_order  = LCD_RGB_ELEMENT_ORDER_RGB,
        /* fb[] is a plain uint16_t array in the CPU's native little-endian
         * layout — tell the controller to read it that way instead of
         * swapping bytes (which corrupted every asymmetric RGB565 color,
         * e.g. cyan 0x07FF arriving as 0xFF07 / yellow). */
        .data_endian    = LCD_RGB_DATA_ENDIAN_LITTLE,
        .bits_per_pixel = 16,
    };
    ESP_ERROR_CHECK(esp_lcd_new_panel_st7789(io_handle, &panel_cfg, &panel_handle));

    /* 4. Reset, init, configure */
    ESP_ERROR_CHECK(esp_lcd_panel_reset(panel_handle));
    ESP_ERROR_CHECK(esp_lcd_panel_init(panel_handle));
    ESP_ERROR_CHECK(esp_lcd_panel_invert_color(panel_handle, true));
    ESP_ERROR_CHECK(esp_lcd_panel_swap_xy(panel_handle, false));
    ESP_ERROR_CHECK(esp_lcd_panel_mirror(panel_handle, false, false));
    ESP_ERROR_CHECK(esp_lcd_panel_disp_on_off(panel_handle, true));

    /* 5. Backlight on */
    gpio_config_t bl_cfg = {
        .pin_bit_mask = (1ULL << BOARD_LCD_PIN_BL),
        .mode         = GPIO_MODE_OUTPUT,
        .pull_up_en   = GPIO_PULLUP_DISABLE,
        .pull_down_en = GPIO_PULLDOWN_DISABLE,
        .intr_type    = GPIO_INTR_DISABLE,
    };
    gpio_config(&bl_cfg);
    gpio_set_level(BOARD_LCD_PIN_BL, 1);

    /* 6. Framebuffer in PSRAM */
    fb = heap_caps_malloc(FB_BYTES, MALLOC_CAP_SPIRAM | MALLOC_CAP_8BIT);
    assert(fb);

    /* Persistent internal DMA-capable flush bounce buffers — see fb_flush(). */
    for (int i = 0; i < FLUSH_BUFS; i++) {
        s_flush_buf[i] = heap_caps_malloc(
            (size_t)BOARD_LCD_H_RES * FLUSH_BAND_ROWS * sizeof(uint16_t),
            MALLOC_CAP_DMA | MALLOC_CAP_INTERNAL);
        assert(s_flush_buf[i]);
    }

    /* 7. Boot test pattern — colored bars + text */
    const int bar_h = BOARD_LCD_V_RES / 6;

    uint16_t colors[] = {
        rgb565(0xFF, 0x00, 0x00), /* red    */
        rgb565(0x00, 0xFF, 0x00), /* green  */
        rgb565(0x00, 0x00, 0xFF), /* blue   */
        rgb565(0xFF, 0xFF, 0x00), /* yellow */
        rgb565(0x00, 0xFF, 0xFF), /* cyan   */
        rgb565(0xFF, 0x00, 0xFF), /* magenta*/
    };

    for (int i = 0; i < 6; i++) {
        int y0 = i * bar_h;
        int y1 = (i + 1) * bar_h;
        if (i == 5) y1 = BOARD_LCD_V_RES; /* absorb remainder */
        for (int y = y0; y < y1; y++) {
            for (int x = 0; x < BOARD_LCD_H_RES; x++) {
                fb_put(x, y, colors[i]);
            }
        }
    }

    /* Overlay text centered in a dark band */
    const char *title = "echo-pocket";
    const char *sub   = "v1.0 LCD OK";
    int tw1 = (int)strlen(title) * 8;
    int tw2 = (int)strlen(sub) * 8;
    int tx1 = (BOARD_LCD_H_RES - tw1) / 2;
    int tx2 = (BOARD_LCD_H_RES - tw2) / 2;

    /* Dark rectangle behind text */
    for (int y = 90; y < 150; y++) {
        for (int x = 0; x < BOARD_LCD_H_RES; x++) {
            fb_put(x, y, rgb565(0x10, 0x10, 0x18));
        }
    }

    display_draw_text(tx1, 96,  title, rgb565(0xFF, 0xFF, 0xFF));
    display_draw_text(tx2, 120, sub,   rgb565(0x80, 0xC0, 0xFF));

    fb_flush();

    ESP_LOGI(TAG, "LCD initialized OK");
}

/* In-memory only — every caller is at the top of a screen's draw()/
 * _screen_draw() function, which ui_task always follows with its own
 * display_flush() once the whole frame is composed. Flushing here too
 * used to push a solid-color frame to the physical LCD before the real
 * content was drawn, doubling the SPI writes (and the tearing exposure)
 * per render and showing up as a flash / ghost content on screen. */
void display_clear(uint16_t color)
{
    if (!fb) return;
    fb_fill(color);
}

void display_flush(void)
{
    if (!fb) return;
    fb_flush();
}

void display_draw_text(int x, int y, const char *text, uint16_t color)
{
    if (!fb || !text) return;

    while (*text) {
        char c = *text++;
        if (c < 0x20 || c > 0x7E) {
            c = ' '; /* non-printable → space */
        }
        const uint8_t *glyph = font8x16[c - 0x20];

        for (int row = 0; row < 16; row++) {
            uint8_t bits = glyph[row];
            for (int col = 0; col < 8; col++) {
                if (bits & (0x80 >> col)) {
                    fb_put(x + col, y + row, color);
                }
            }
        }
        x += 8;
    }
}

void display_fill_rect(int x, int y, int w, int h, uint16_t color)
{
    if (!fb) return;
    /* Clip to bounds */
    if (x < 0) { w += x; x = 0; }
    if (y < 0) { h += y; y = 0; }
    if (x + w > BOARD_LCD_H_RES) w = BOARD_LCD_H_RES - x;
    if (y + h > BOARD_LCD_V_RES) h = BOARD_LCD_V_RES - y;
    if (w <= 0 || h <= 0) return;

    for (int row = y; row < y + h; row++) {
        for (int col = x; col < x + w; col++) {
            fb[row * BOARD_LCD_H_RES + col] = color;
        }
    }
}

void display_fill_rounded_rect(int x, int y, int w, int h, int radius, uint16_t color)
{
    if (!fb || w <= 0 || h <= 0) return;
    if (radius <= 0) { display_fill_rect(x, y, w, h, color); return; }
    if (radius > w / 2) radius = w / 2;
    if (radius > h / 2) radius = h / 2;

    /* Corner arcs are anti-aliased by blending edge pixels with whatever's
     * already in the framebuffer, based on fractional circle coverage —
     * a hard in/out pixel mask stairsteps visibly at this radius. */
    float r = (float)radius;
    float cy_top = y + r - 0.5f;
    float cy_bot = y + h - r - 0.5f;
    float cx_left  = x + r - 0.5f;
    float cx_right = x + w - r - 0.5f;

    for (int row = 0; row < h; row++) {
        int py = y + row;
        int top    = row < radius;
        int bottom = row >= h - radius;

        if (!top && !bottom) {
            display_fill_rect(x, py, w, 1, color);
            continue;
        }
        float cyc = top ? cy_top : cy_bot;
        for (int col = 0; col < w; col++) {
            int px = x + col;
            int left  = col < radius;
            int right = col >= w - radius;

            if (!left && !right) {
                fb_put(px, py, color);
                continue;
            }
            float cxc = left ? cx_left : cx_right;
            float dx = (px + 0.5f) - cxc;
            float dy = (py + 0.5f) - cyc;
            float dist = sqrtf(dx * dx + dy * dy);
            float coverage = r + 0.5f - dist; /* ~1px soft edge */

            if (coverage <= 0.0f) continue;
            if (coverage >= 1.0f) { fb_put(px, py, color); continue; }
            fb_put(px, py, blend565(fb_get(px, py), color, coverage));
        }
    }
}

void display_draw_rect(int x, int y, int w, int h, uint16_t color)
{
    if (!fb) return;
    /* Clip to bounds */
    if (x < 0) { w += x; x = 0; }
    if (y < 0) { h += y; y = 0; }
    if (x + w > BOARD_LCD_H_RES) w = BOARD_LCD_H_RES - x;
    if (y + h > BOARD_LCD_V_RES) h = BOARD_LCD_V_RES - y;
    if (w <= 0 || h <= 0) return;

    /* Top edge */
    for (int col = x; col < x + w; col++) fb_put(col, y, color);
    /* Bottom edge */
    for (int col = x; col < x + w; col++) fb_put(col, y + h - 1, color);
    /* Left edge */
    for (int row = y + 1; row < y + h - 1; row++) fb_put(x, row, color);
    /* Right edge */
    for (int row = y + 1; row < y + h - 1; row++) fb_put(x + w - 1, row, color);
}

void display_fill_circle(int cx, int cy, int r, uint16_t color)
{
    if (!fb || r < 0) return;
    if (r == 0) { fb_put(cx, cy, color); return; }

    /* Midpoint circle algorithm — draw horizontal spans */
    int dx = r;
    int dy = 0;
    int err = 1 - r;

    while (dx >= dy) {
        /* Horizontal spans for this y value */
        for (int col = cx - dx; col <= cx + dx; col++) {
            fb_put(col, cy + dy, color);
            fb_put(col, cy - dy, color);
        }
        for (int col = cx - dy; col <= cx + dy; col++) {
            fb_put(col, cy + dx, color);
            fb_put(col, cy - dx, color);
        }

        dy++;
        if (err <= 0) {
            err += 2 * dy + 1;
        } else {
            dx--;
            err += 2 * (dy - dx) + 1;
        }
    }
}

void display_draw_smile_arc(int cx, int cy, int r, int half_width, int thickness, uint16_t color)
{
    if (!fb || r <= 0) return;
    if (thickness < 1) thickness = 1;
    if (half_width <= 0 || half_width > r) half_width = r;

    /* Offset so the curve's endpoints (dx = ±half_width) sit at cy even
     * when half_width < r — a bigger r with the same half_width traces a
     * shallower arc between those endpoints, i.e. a flatter smile. */
    float edge_dy = sqrtf((float)(r * r - half_width * half_width));
    for (int dx = -half_width; dx <= half_width; dx++) {
        int dy = (int)(sqrtf((float)(r * r - dx * dx)) - edge_dy);
        for (int t = 0; t < thickness; t++) {
            fb_put(cx + dx, cy + dy - t, color);
        }
    }
}

void display_draw_hline(int x, int y, int w, uint16_t color)
{
    if (!fb) return;
    if (x < 0) { w += x; x = 0; }
    if (x + w > BOARD_LCD_H_RES) w = BOARD_LCD_H_RES - x;
    if (w <= 0 || y < 0 || y >= BOARD_LCD_V_RES) return;

    for (int col = x; col < x + w; col++) {
        fb_put(col, y, color);
    }
}
